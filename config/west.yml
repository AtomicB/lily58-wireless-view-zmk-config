## config/west.yml
```yaml
manifest:
  remotes:
    - name: zmkfirmware
      url-base: https://github.com/zmkfirmware
    - name: zmklocales_base 
      url-base: https://github.com/joelspadin/zmk-locales
  projects:
    - name: zmk
      remote: zmkfirmware
      revision: main
      import: app/west.yml
    - name: zmklocales
      remote: zmklocales_base 
      revision: main 
  self:
    path: config
```
